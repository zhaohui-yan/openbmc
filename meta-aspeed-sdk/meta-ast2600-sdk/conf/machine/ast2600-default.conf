## meta-aspeed-sdk/meta-ast2600-sdk/conf/machine/ast2600-default.conf
```bitbake
require conf/machine/include/ast2600-sdk.inc
require conf/machine/include/ast-ssp.inc

# Overwrite flash layout
FLASH_SIZE = "65536"
FLASH_UBOOT_SPL_SIZE = "64"
FLASH_UBOOT_OFFSET = "0"
FLASH_KERNEL_OFFSET = "1024"
FLASH_ROFS_OFFSET = "10240"
FLASH_RWFS_OFFSET = "43008"

# U-Boot Build Settings
UBOOT_MACHINE = "evb-ast2600-spl_defconfig"
UBOOT_DEVICETREE = "ast2600-evb"
SPL_BINARY = "spl/u-boot-spl.bin"
UBOOT_SIGN_ENABLE = "1"
UBOOT_FITIMAGE_ENABLE = "1"

# Kernel Build Settings
KERNEL_DEVICETREE = "aspeed-ast2600-evb.dtb"
KBUILD_DEFCONFIG = "aspeed_g6_defconfig"

MACHINE_FEATURES += "\
        obmc-phosphor-fan-mgmt \
        obmc-phosphor-chassis-mgmt \
        obmc-phosphor-flash-mgmt \
        obmc-host-ipmi \
        obmc-host-state-mgmt \
        obmc-chassis-state-mgmt \
        obmc-bmc-state-mgmt \
        "

PREFERRED_PROVIDER_virtual/obmc-system-mgmt = "packagegroup-aspeed-obmc"
PREFERRED_PROVIDER_virtual/obmc-host-ipmi-hw = "phosphor-ipmi-kcs"
VIRTUAL-RUNTIME_obmc-host-state-manager ?= "x86-power-control"
VIRTUAL-RUNTIME_obmc-chassis-state-manager ?= "x86-power-control"

EXTRA_IMAGEDEPENDS:append = " \
    aspeed-image-recoveryuart \
    "
```

## meta-aspeed-sdk/meta-ast2600-sdk/conf/machine/ast2600-emmc-secure.conf
```bitbake
require conf/machine/ast2600-emmc.conf
require conf/machine/include/ast2600-secure.inc

# Secure Boot Settings
ASPEED_SECURE_BOOT_CONFIG = "ast2600-emmc_secure.cfg"
```

## meta-aspeed-sdk/meta-ast2600-sdk/conf/machine/ast2600-emmc.conf
```bitbake
require conf/machine/include/ast2600-sdk.inc
require conf/machine/include/ast-mmc.inc
# remove phosphor-mmc distro feature if build aspeed-image-sdk
require ${@bb.utils.contains('INITRAMFS_IMAGE', 'aspeed-image-initramfs', '', 'conf/distro/include/phosphor-mmc.inc', d)}
require conf/machine/include/ast-ssp.inc

# eMMC Partition Layout File
WKS_FILE = "ast2600-emmc.wks.in"

# U-Boot Build Settings
UBOOT_MACHINE = "evb-ast2600-emmc_defconfig"
UBOOT_DEVICETREE = "ast2600-evb"
SPL_BINARY = "spl/u-boot-spl.bin"
UBOOT_SIGN_ENABLE = "1"
UBOOT_FITIMAGE_ENABLE = "1"

# Kernel Build Settings
KERNEL_DEVICETREE = "aspeed-ast2600-evb.dtb"
KBUILD_DEFCONFIG = "aspeed_g6_defconfig"

# MMC u-boot and kernel partition size
MMC_UBOOT_SIZE = "1024"
MMC_BOOT_PARTITION_SIZE = "24576"

OBMC_MACHINE_FEATURES += "\
        obmc-phosphor-fan-mgmt \
        obmc-phosphor-chassis-mgmt \
        obmc-phosphor-flash-mgmt \
        obmc-host-ipmi \
        obmc-host-state-mgmt \
        obmc-chassis-state-mgmt \
        obmc-bmc-state-mgmt \
        "

PREFERRED_PROVIDER_virtual/obmc-system-mgmt = "packagegroup-aspeed-obmc"
PREFERRED_PROVIDER_virtual/obmc-host-ipmi-hw = "phosphor-ipmi-kcs"
VIRTUAL-RUNTIME_obmc-host-state-manager ?= "x86-power-control"
VIRTUAL-RUNTIME_obmc-chassis-state-manager ?= "x86-power-control"

EXTRA_IMAGEDEPENDS:append = "\
    aspeed-image-recoveryuart \
    aspeed-image-emmcboot \
    "
```

## meta-aspeed-sdk/meta-ast2600-sdk/conf/machine/ast2600-pfr-515.conf
```bitbake
require conf/machine/ast2600-pfr.conf

PREFERRED_VERSION_linux-aspeed = "5.15.%"
```

## meta-aspeed-sdk/meta-ast2600-sdk/conf/machine/ast2600-secure-rsa2048-sha256-ncot.conf
```bitbake
require conf/machine/ast2600-default.conf
require conf/machine/include/ast2600-secure.inc

# Secure Boot Settings
ASPEED_SECURE_BOOT_CONFIG = "ast2600-secure_RSA2048_SHA256_ncot.cfg"

# OpenBMC Settings
FLASH_UBOOT_IMAGE = "u-boot"
FLASH_KERNEL_IMAGE = "fitImage-${INITRAMFS_IMAGE}-${MACHINE}-${MACHINE}"
FLASH_KERNEL_IMAGE_df-obmc-ubi-fs = "fitImage-${MACHINE}.bin"

# ASPEED Initramfs Settings
ASPEED_IMAGE_UBOOT_IMAGE = "u-boot"
ASPEED_IMAGE_KERNEL_IMAGE = "fitImage-${INITRAMFS_IMAGE}-${MACHINE}-${MACHINE}"
```

## meta-aspeed-sdk/meta-ast2600-sdk/conf/machine/ast2600-secure-rsa2048-sha256-o2-pub.conf
```bitbake
require conf/machine/ast2600-default.conf
require conf/machine/include/ast2600-secure.inc

# Secure Boot Settings
ASPEED_SECURE_BOOT_CONFIG = "ast2600-secure_RSA2048_SHA256_o2_pub.cfg"
```

## meta-aspeed-sdk/meta-ast2600-sdk/conf/machine/ast2600-secure-rsa2048-sha256.conf
```bitbake
require conf/machine/ast2600-default.conf
require conf/machine/include/ast2600-secure.inc
# Secure Boot Settings for CoT
require conf/machine/include/ast2600-secure-rsa2048-sha256-cot.inc

# Secure Boot Settings for OTP and RoT
ASPEED_SECURE_BOOT_CONFIG ?= "ast2600-secure_RSA2048_SHA256.cfg"
```

## meta-aspeed-sdk/meta-ast2600-sdk/conf/machine/ast2600-secure-rsa3072-sha384-o1.conf
```bitbake
require conf/machine/ast2600-default.conf
require conf/machine/include/ast2600-secure.inc

# Secure Boot Settings
ASPEED_SECURE_BOOT_CONFIG = "ast2600-secure_RSA3072_SHA384_o1.cfg"
```

## meta-aspeed-sdk/meta-ast2600-sdk/conf/machine/ast2600-secure-rsa3072-sha384.conf
```bitbake
require conf/machine/ast2600-default.conf
require conf/machine/include/ast2600-secure.inc
# Secure Boot Settings for CoT
require conf/machine/include/ast2600-secure-rsa3072-sha384-cot.inc

# Secure Boot Settings for OTP and RoT
ASPEED_SECURE_BOOT_CONFIG ?= "ast2600-secure_RSA3072_SHA384.cfg"
```

## meta-aspeed-sdk/meta-ast2600-sdk/conf/machine/ast2600-secure-rsa4096-sha512.conf
```bitbake
require conf/machine/ast2600-default.conf
require conf/machine/include/ast2600-secure.inc
# Secure Boot Settings for CoT
require conf/machine/include/ast2600-secure-rsa4096-sha512-cot.inc

# Secure Boot Settings for OTP and RoT
ASPEED_SECURE_BOOT_CONFIG ?= "ast2600-secure_RSA4096_SHA512.cfg"
```

## meta-aspeed-sdk/meta-ast2600-sdk/conf/machine/ast2600-usbadp.conf
```bitbake
require conf/machine/ast2600-default.conf

KERNEL_DEVICETREE = "aspeed-ast2600-usbadp.dtb"
```

## meta-aspeed-sdk/meta-ast2600-sdk/conf/machine/ast2605-default.conf
```bitbake
require conf/machine/include/ast2600-sdk.inc
require conf/machine/include/ast-ssp.inc
require conf/machine/include/ast2605-ssp.inc

# Overwrite flash layout
FLASH_SIZE = "65536"
FLASH_AST2605_SSP_SIZE = "64"
FLASH_UBOOT_OFFSET = "0"
FLASH_KERNEL_OFFSET = "1024"
FLASH_ROFS_OFFSET = "10240"
FLASH_RWFS_OFFSET = "43008"

# U-Boot Build Settings
UBOOT_MACHINE = "evb-ast2605_defconfig"
UBOOT_DEVICETREE = "ast2600-evb"
AST2605_SSP_BINARY = "boot.bin"

UBOOT_ENTRYPOINT:aspeed-g6 = "0x82008000"
UBOOT_LOADADDRESS:aspeed-g6 = "0x82008000"
# We use zephyr.bin in https://github.com/AspeedTech-BMC/rom-patcher as the default ssp image.
# zephyr.bin will be patched by rom-patcher during the build process.
# If you want to use another ssp image that need to be patched by rom-patcher, please
# unmark AST2605_SSP_PATH and assign the absolute path of your unpatched ssp image.

#AST2605_SSP_PATH = "/path/to/ssp/image.bin"

# If you already have a patched ssp image that needn't to be patched by rom-patcher,
# please unmark AST2605_PATCHED_SSP_PATH and assign the absolute path of the patched image.

#AST2605_PATCHED_SSP_PATH = "/path/to/patched/ssp/image.bin"

# Kernel Build Settings
KERNEL_DEVICETREE = "aspeed-ast2600-evb.dtb"
KBUILD_DEFCONFIG = "aspeed_ast2605_defconfig"
KERNEL_EXTRA_ARGS += "ZRELADDR=0x82008000"

MACHINE_FEATURES += "\
        obmc-phosphor-fan-mgmt \
        obmc-phosphor-chassis-mgmt \
        obmc-phosphor-flash-mgmt \
        obmc-host-ipmi \
        obmc-host-state-mgmt \
        obmc-chassis-state-mgmt \
        obmc-bmc-state-mgmt \
        "

PREFERRED_PROVIDER_virtual/obmc-system-mgmt = "packagegroup-aspeed-obmc"
PREFERRED_PROVIDER_virtual/obmc-host-ipmi-hw = "phosphor-ipmi-kcs"
VIRTUAL-RUNTIME_obmc-host-state-manager ?= "x86-power-control"
VIRTUAL-RUNTIME_obmc-chassis-state-manager ?= "x86-power-control"
```

## meta-ast2600-sdk/conf/machine/ast2600-a1-secure-rsa2048-sha256-o1.conf
```bitbake
require conf/machine/ast2600-a1.conf
require conf/machine/include/ast2600-secure.inc

# U-Boot Build Settings
UBOOT_MACHINE = "evb-ast2600a1-cot_defconfig"

# Secure Boot Settings
ASPEED_SECURE_BOOT_CONFIG = "ast2600-a1-secure-rsa2048-sha256-o1.cfg"
```

## meta-ast2600-sdk/conf/machine/ast2600-a1-secure-rsa3072-sha384-o2-priv.conf
```bitbake
require conf/machine/ast2600-a1.conf
require conf/machine/include/ast2600-secure.inc

# U-Boot Build Settings
UBOOT_MACHINE = "evb-ast2600a1-cot_defconfig"

# Secure Boot Settings
ASPEED_SECURE_BOOT_CONFIG = "ast2600-a1-secure-rsa3072-sha384-o2-priv.cfg"
```

## meta-ast2600-sdk/conf/machine/ast2600-a1-secure-rsa4096-sha512-o2-priv.conf
```bitbake
require conf/machine/ast2600-a1.conf
require conf/machine/include/ast2600-secure.inc

# U-Boot Build Settings
UBOOT_MACHINE = "evb-ast2600a1-cot_defconfig"

# Secure Boot Settings
ASPEED_SECURE_BOOT_CONFIG = "ast2600-a1_secure_RSA4096_SHA512_o2_priv.cfg"
```

## meta-ast2600-sdk/conf/machine/ast2600-a1.conf
```bitbake
require conf/machine/include/ast2600-sdk.inc
require conf/machine/include/ast-ssp.inc

# Overwrite flash layout
FLASH_SIZE = "65536"
FLASH_UBOOT_SPL_SIZE = "64"
FLASH_UBOOT_OFFSET = "0"
FLASH_KERNEL_OFFSET = "1024"
FLASH_ROFS_OFFSET = "10240"
FLASH_RWFS_OFFSET = "43008"

# U-Boot Build Settings
UBOOT_MACHINE = "evb-ast2600a1-spl_defconfig"
UBOOT_DEVICETREE = "ast2600a1-evb"
SPL_BINARY = "spl/u-boot-spl.bin"

# Kernel Build Settings
# ASPEED ast2600a1 evb dtb file if build aspeed-image-sdk
KERNEL_DEVICETREE_df-ast-img-sdk = "aspeed-ast2600a1-evb.dtb"
KERNEL_DEVICETREE = "aspeed-ast2600a1-obmc.dtb"
KBUILD_DEFCONFIG = "aspeed_g6_defconfig"

OBMC_MACHINE_FEATURES += "\
        obmc-phosphor-fan-mgmt \
        obmc-phosphor-chassis-mgmt \
        obmc-phosphor-flash-mgmt \
        obmc-host-ipmi \
        obmc-host-state-mgmt \
        obmc-chassis-state-mgmt \
        obmc-bmc-state-mgmt \
        "

PREFERRED_PROVIDER_virtual/obmc-system-mgmt = "packagegroup-aspeed"
PREFERRED_PROVIDER_virtual/obmc-host-ipmi-hw = "phosphor-ipmi-kcs"
VIRTUAL-RUNTIME_obmc-host-state-manager ?= "x86-power-control"
VIRTUAL-RUNTIME_obmc-chassis-state-manager ?= "x86-power-control"

EXTRA_IMAGEDEPENDS_append = " \
    aspeed-image-recoveryuart \
    "
```

## meta-ast2600-sdk/conf/machine/ast2600-emmc.conf
```bitbake
require conf/machine/include/ast2600-sdk.inc
require conf/distro/include/phosphor-mmc.inc

# eMMC Partition Layout File
WKS_FILE = "${MACHINE}.wks.in"

# U-Boot Build Settings
UBOOT_MACHINE = "evb-ast2600-obmc-emmc_defconfig"
UBOOT_DEVICETREE = "ast2600-evb"
SPL_BINARY = "spl/u-boot-spl.bin"

# Kernel Build Settings
KERNEL_DEVICETREE = "aspeed-ast2600-obmc.dtb"
KBUILD_DEFCONFIG = "aspeed_g6_defconfig"

OBMC_MACHINE_FEATURES += "\
        obmc-phosphor-fan-mgmt \
        obmc-phosphor-chassis-mgmt \
        obmc-phosphor-flash-mgmt \
        obmc-host-ipmi \
        obmc-host-state-mgmt \
        obmc-chassis-state-mgmt \
        obmc-bmc-state-mgmt \
        "

PREFERRED_PROVIDER_virtual/obmc-system-mgmt = "packagegroup-aspeed"
PREFERRED_PROVIDER_virtual/obmc-host-ipmi-hw = "phosphor-ipmi-kcs"
VIRTUAL-RUNTIME_obmc-host-state-manager ?= "x86-power-control"
VIRTUAL-RUNTIME_obmc-chassis-state-manager ?= "x86-power-control"

EXTRA_IMAGEDEPENDS_append = " aspeed-image-recoveryuart"
```

## meta-ast2600-sdk/conf/machine/ast2600-secure-rsa2048-sha256-o2-priv.conf
```bitbake
require conf/machine/ast2600-default.conf
require conf/machine/include/ast2600-secure.inc

# U-Boot Build Settings
UBOOT_MACHINE = "evb-ast2600-cot_defconfig"

# Secure Boot Settings
ASPEED_SECURE_BOOT_CONFIG = "ast2600-secure_RSA2048_SHA256_o2_priv.cfg"
```

## meta-ast2600-sdk/conf/machine/ast2600-secure-rsa2048-sha256.conf
```bitbake
require conf/machine/ast2600-default.conf

# U-Boot Build Settings
UBOOT_MACHINE = "evb-ast2600-cot_defconfig"

# Secure Boot Settings
ASPEED_SECURE_BOOT_TARGET = "ast2600"
ASPEED_SECURE_BOOT_CONFIG = "ast2600-secure-rsa2048-sha256.cfg"

# OpenBMC Settings
FLASH_UBOOT_SPL_IMAGE = "s-u-boot-spl"
FLASH_UBOOT_IMAGE = "s-u-boot"
FLASH_KERNEL_IMAGE = "s-fitImage-${INITRAMFS_IMAGE}-${MACHINE}-${MACHINE}"
FLASH_KERNEL_IMAGE_df-obmc-ubi-fs = "s-fitImage-${MACHINE}.bin"

# ASPEED Initramfs Settings
ASPEED_IMAGE_UBOOT_SPL_IMAGE ?= "s-u-boot-spl"
ASPEED_IMAGE_UBOOT_IMAGE ?= "s-u-boot"
ASPEED_IMAGE_KERNEL_IMAGE ?= "s-fitImage-${INITRAMFS_IMAGE}-${MACHINE}-${MACHINE}"

MACHINE_FEATURES_append = " ast-secure"
```

## meta-ast2600-sdk/conf/machine/ast2600-secure-rsa3072-sha384.conf
```bitbake
require conf/machine/ast2600-default.conf
require conf/machine/include/ast2600-secure.conf

# U-Boot Build Settings
UBOOT_MACHINE = "evb-ast2600-cot_defconfig"

# Secure Boot Settings
ASPEED_SECURE_BOOT_CONFIG = "ast2600-secure-rsa3072-sha384.cfg"
```

## meta-ast2600-sdk/conf/machine/ast2600-secure-rsa4096-sha512-o2-pub.conf
```bitbake
require conf/machine/ast2600-default.conf
require conf/machine/include/ast2600-secure.inc

# U-Boot Build Settings
UBOOT_MACHINE = "evb-ast2600-cot_defconfig"

# Secure Boot Settings
ASPEED_SECURE_BOOT_CONFIG = "ast2600-secure_RSA4096_SHA512_o2_pub.cfg"
```

## meta-ast2600-sdk/conf/machine/include/ast2600-secure.conf
```bitbake
# Secure Boot Settings
MACHINE_FEATURES_append = " ast-secure"
ASPEED_SECURE_BOOT_TARGET = "ast2600"

# OpenBMC Settings
FLASH_UBOOT_SPL_IMAGE = "s-u-boot-spl"
FLASH_UBOOT_IMAGE = "s-u-boot"
FLASH_KERNEL_IMAGE = "s-fitImage-${INITRAMFS_IMAGE}-${MACHINE}-${MACHINE}"
FLASH_KERNEL_IMAGE_df-obmc-ubi-fs = "s-fitImage-${MACHINE}.bin"

# ASPEED Initramfs Settings
ASPEED_IMAGE_UBOOT_SPL_IMAGE = "s-u-boot-spl"
ASPEED_IMAGE_UBOOT_IMAGE = "s-u-boot"
ASPEED_IMAGE_KERNEL_IMAGE = "s-fitImage-${INITRAMFS_IMAGE}-${MACHINE}-${MACHINE}"
```

## meta-ast2600-sdk/conf/machine/include/ast2600-secure.inc
```bitbake
# Secure Boot Settings
require conf/machine/include/ast-secure.inc

ASPEED_SECURE_BOOT_TARGET = "ast2600"

# OpenBMC Settings
FLASH_UBOOT_SPL_IMAGE = "s_u-boot-spl"
FLASH_UBOOT_IMAGE = "s_u-boot"
FLASH_KERNEL_IMAGE = "s_fitImage-${INITRAMFS_IMAGE}-${MACHINE}-${MACHINE}"
FLASH_KERNEL_IMAGE_df-obmc-ubi-fs = "s_fitImage-${MACHINE}.bin"
# OpenBMC EMMC settings
IMAGE_BOOT_FILES = "s_fitImage-${INITRAMFS_IMAGE}-${MACHINE}-${MACHINE};s_fitImage"

# ASPEED Initramfs Settings
ASPEED_IMAGE_UBOOT_SPL_IMAGE = "s_u-boot-spl"
ASPEED_IMAGE_UBOOT_IMAGE = "s_u-boot"
ASPEED_IMAGE_KERNEL_IMAGE = "s_fitImage-${INITRAMFS_IMAGE}-${MACHINE}-${MACHINE}"

# ASPEED EMMC Settings
ASPEED_EMMC_IMAGE_UBOOT_SPL_IMAGE = "s_u-boot-spl"
ASPEED_EMMC_IMAGE_UBOOT_IMAGE = "s_u-boot"
ASPEED_EMMC_IMAGE_MERGE_UBOOT_IMAGE = "s_emmc_image-u-boot"
```
