## meta-ts1000/conf/layer.conf
```bitbake
# We have a conf and classes directory, add to BBPATH
BBPATH .= ":${LAYERDIR}"

BBFILES += "${LAYERDIR}/recipes-*/*/*.bb \
            ${LAYERDIR}/recipes-*/*/*.bbappend"

BBFILE_COLLECTIONS += "ts1000-layer"
BBFILE_PATTERN_ts1000-layer := "^${LAYERDIR}/"
LAYERVERSION_ts1000-layer = "1"
LAYERSERIES_COMPAT_ts1000-layer = "nanbield scarthgap"

# Provide a variable that points the base of the aspeed-sdk layer.
ASPEEDSDKBASE = '${@os.path.normpath("${LAYERDIR}/")}'

BBFILES_DYNAMIC += " \
    meta-arm:${LAYERDIR}/dynamic-layers/arm-layer/recipes-*/*/*.bb \
    meta-arm:${LAYERDIR}/dynamic-layers/arm-layer/recipes-*/*/*.bbappend \
    zephyrcore:${LAYERDIR}/dynamic-layers/zephyrcore-layer/recipes-*/*/*.bb \
    zephyrcore:${LAYERDIR}/dynamic-layers/zephyrcore-layer/recipes-*/*/*.bbappend \
"
```

## meta-ts1000/meta-ast2500-sdk/conf/machine/TS1000.conf
```bitbake
require conf/machine/include/ast2500-sdk.inc
require conf/machine/include/obmc-bsp-common.inc

# Overwrite flash layout
FLASH_SIZE = "32768"
FLASH_UBOOT_OFFSET = "0"
FLASH_UBOOT_ENV_OFFSET = "960"
FLASH_KERNEL_OFFSET = "1024"
FLASH_ROFS_OFFSET = "6144"
# FLASH_RWFS_OFFSET = "29952"
# RWFS_SIZE = "2883584"
FLASH_RWFS_OFFSET = "30720"
RWFS_SIZE = "2359296"



# U-Boot Build Settings
UBOOT_MACHINE = "evb-ast2500_defconfig"
# UBOOT_DEVICETREE = "ast2500-evb"
UBOOT_DEVICETREE = "ast2500-se8"

# Kernel Build Settings
# KERNEL_DEVICETREE = "aspeed/aspeed-ast2500-evb.dtb"
# KERNEL_DEVICETREE = "aspeed-sophgo-se8.dtb"
KERNEL_DEVICETREE = "aspeed/aspeed-ast2500-se8.dtb"
# KBUILD_DEFCONFIG = "aspeed_g5_defconfig"
KBUILD_DEFCONFIG = "aspeed_g5_se8_deconfig"
# PREFERRED_VERSION_linux-aspeed = "5.4.%"
# PREFERRED_VERSION_linux-aspeed = "5.1.%"
# PREFERRED_VERSION_linux-aspeed = "5.15.%"

MACHINE_FEATURES += "\
        obmc-phosphor-fan-mgmt \
        obmc-phosphor-chassis-mgmt \
        obmc-phosphor-flash-mgmt \
        obmc-host-ipmi \
        obmc-host-state-mgmt \
        obmc-chassis-state-mgmt \
        obmc-bmc-state-mgmt \
        "

PREFERRED_PROVIDER_virtual/obmc-system-mgmt = "packagegroup-aspeed-obmc"
PREFERRED_PROVIDER_virtual/obmc-host-ipmi-hw = "phosphor-ipmi-kcs"
VIRTUAL-RUNTIME_obmc-host-state-manager = "sophgo-se8-power-control"
VIRTUAL-RUNTIME_obmc-chassis-state-manager = "sophgo-se8-power-control"
```
