## conf/layer.conf
```bitbake
# We have a conf and classes directory, add to BBPATH
BBPATH .= ":${LAYERDIR}"

BBFILES += "${LAYERDIR}/recipes-*/*/*.bb \
            ${LAYERDIR}/recipes-*/*/*.bbappend"

BBFILE_COLLECTIONS += "aspeed-sdk-layer"
BBFILE_PATTERN_aspeed-sdk-layer := "^${LAYERDIR}/"
LAYERVERSION_aspeed-sdk-layer = "1"
LAYERSERIES_COMPAT_aspeed-sdk-layer = "dunfell gatesgarth hardknott"

# Provide a variable that points the base of the aspeed-sdk layer.
ASPEEDSDKBASE = '${@os.path.normpath("${LAYERDIR}/")}'
```

## meta-aspeed-sdk/conf/machine/include/ast-abr.inc
```bitbake
# Enabling AST2600 Alternate Boot Record(ABR) functionality

MACHINE_FEATURES_append = " ast-abr "
MACHINEOVERRIDES .= ":ast-abr"
```

## meta-aspeed-sdk/conf/machine/include/ast-ssp.inc
```bitbake
MACHINE_FEATURES_append = " ast-ssp"

# Do not load the "aspeed-ssp" module on boot.
KERNEL_MODULE_PROBECONF_append = " aspeed-ssp"
module_conf_aspeed-ssp = "blacklist aspeed-ssp"
```

## meta-aspeed-sdk/meta-ast2500-sdk/conf/machine/ast2500-default-54.conf
```bitbake
require conf/machine/ast2500-default.conf

PREFERRED_VERSION_linux-aspeed = "5.4.%"
```

## meta-aspeed-sdk/meta-ast2500-sdk/conf/machine/ast2500-default.conf
```bitbake
require conf/machine/include/ast2500-sdk.inc
require conf/machine/include/obmc-bsp-common.inc

# Overwrite flash layout
FLASH_SIZE = "32768"
FLASH_UBOOT_OFFSET = "0"
FLASH_KERNEL_OFFSET = "1024"
FLASH_ROFS_OFFSET = "6144"
FLASH_RWFS_OFFSET = "29952"
RWFS_SIZE = "2883584"

# U-Boot Build Settings
UBOOT_MACHINE = "evb-ast2500_defconfig"
UBOOT_DEVICETREE = "ast2500-evb"

# Kernel Build Settings
KERNEL_DEVICETREE = "aspeed-ast2500-evb.dtb"
KBUILD_DEFCONFIG = "aspeed_g5_defconfig"

MACHINE_FEATURES += "\
        obmc-phosphor-fan-mgmt \
        obmc-phosphor-chassis-mgmt \
        obmc-phosphor-flash-mgmt \
        obmc-host-ipmi \
        obmc-host-state-mgmt \
        obmc-chassis-state-mgmt \
        obmc-bmc-state-mgmt \
        "

PREFERRED_PROVIDER_virtual/obmc-system-mgmt = "packagegroup-aspeed-obmc"
PREFERRED_PROVIDER_virtual/obmc-host-ipmi-hw = "phosphor-ipmi-kcs"
VIRTUAL-RUNTIME_obmc-host-state-manager ?= "x86-power-control"
VIRTUAL-RUNTIME_obmc-chassis-state-manager ?= "x86-power-control"
```

## meta-aspeed-sdk/meta-ast2600-pfr/conf/machine/ast2600-dcscm.conf
```bitbake
require conf/machine/include/ast2600-sdk.inc
require conf/machine/include/ast-ssp.inc
require conf/machine/include/obmc-bsp-common.inc

# Overwrite flash layout
FLASH_SIZE = "67712"
FLASH_UBOOT_SPL_SIZE = "64"
FLASH_UBOOT_OFFSET = "0"
FLASH_KERNEL_OFFSET = "21632"
FLASH_ROFS_OFFSET = "30848"
FLASH_RWFS_OFFSET = "3200"

# PFR settings
PFR_IMAGE_SIZE = "262144"
# 0x000E0000
PFM_OFFSET_PAGE = "896"
# 0x04220000
RC_IMAGE_PAGE = "67712"
PFR_MANIFEST = "pfr_manifest_ast2600_dcscm.json"
# 1 = SHA256
# 2 = SHA384
PFR_SHA = "2"

# U-Boot Build Settings
UBOOT_MACHINE = "ast2600-pfr_defconfig"
UBOOT_DEVICETREE = "ast2600-dcscm"
SPL_BINARY = "spl/u-boot-spl.bin"
UBOOT_SIGN_ENABLE = "1"
UBOOT_FITIMAGE_ENABLE = "1"

# Kernel Build Settings
KERNEL_DEVICETREE = "aspeed-ast2600-dcscm.dtb"
KBUILD_DEFCONFIG = "aspeed_g6_defconfig"

MACHINE_FEATURES += "\
        obmc-phosphor-fan-mgmt \
        obmc-phosphor-chassis-mgmt \
        obmc-phosphor-flash-mgmt \
        obmc-host-ipmi \
        obmc-host-state-mgmt \
        obmc-chassis-state-mgmt \
        obmc-bmc-state-mgmt \
        "

PREFERRED_PROVIDER_virtual/obmc-system-mgmt = "packagegroup-aspeed-obmc"
PREFERRED_PROVIDER_virtual/obmc-host-ipmi-hw = "phosphor-ipmi-kcs"
VIRTUAL-RUNTIME_obmc-host-state-manager ?= "x86-power-control"
VIRTUAL-RUNTIME_obmc-chassis-state-manager ?= "x86-power-control"

EXTRA_IMAGEDEPENDS:append = " \
    aspeed-image-recoveryuart \
    "
```

## meta-aspeed-sdk/meta-ast2600-pfr/conf/machine/ast2600-pfr.conf
```bitbake
require conf/machine/include/ast2600-sdk.inc
require conf/machine/include/ast-ssp.inc
require conf/machine/include/obmc-bsp-common.inc

# Overwrite flash layout
FLASH_SIZE = "43008"
FLASH_UBOOT_SPL_SIZE = "64"
FLASH_UBOOT_OFFSET = "0"
FLASH_KERNEL_OFFSET = "11264"
FLASH_ROFS_OFFSET = "20480"
FLASH_RWFS_OFFSET = "3200"

# PFR settings
PFR_IMAGE_SIZE = "131072"
# 0x000E0000
PFM_OFFSET_PAGE = "896"
# 0x02A00000
RC_IMAGE_PAGE = "43008"
PFR_MANIFEST = "pfr_manifest.json"
# 1 = SHA256
# 2 = SHA384
PFR_SHA = "2"

# U-Boot Build Settings
UBOOT_MACHINE = "ast2600-pfr_defconfig"
UBOOT_DEVICETREE = "ast2600-pfr"
SPL_BINARY = "spl/u-boot-spl.bin"
UBOOT_SIGN_ENABLE = "1"
UBOOT_FITIMAGE_ENABLE = "1"

# Kernel Build Settings
KERNEL_DEVICETREE = "aspeed-ast2600-pfr.dtb"
KBUILD_DEFCONFIG = "aspeed_g6_defconfig"

PREFERRED_PROVIDER_virtual/obmc-system-mgmt = "packagegroup-aspeed-obmc"
PREFERRED_PROVIDER_virtual/obmc-host-ipmi-hw = "phosphor-ipmi-kcs"
VIRTUAL-RUNTIME_obmc-host-state-manager ?= "x86-power-control"
VIRTUAL-RUNTIME_obmc-chassis-state-manager ?= "x86-power-control"

EXTRA_IMAGEDEPENDS:append = " \
    aspeed-image-recoveryuart \
    "

# Remove unneeded binaries from image
IMAGE_FEATURES:remove = "obmc-bmc-state-mgmt"
IMAGE_FEATURES:remove = "obmc-bmcweb"
IMAGE_FEATURES:remove = "obmc-chassis-mgmt"
IMAGE_FEATURES:remove = "obmc-chassis-state-mgmt"
IMAGE_FEATURES:remove = "obmc-console"
IMAGE_FEATURES:remove = "obmc-dbus-monitor"
IMAGE_FEATURES:remove = "obmc-devtools"
IMAGE_FEATURES:remove = "obmc-fan-control"
IMAGE_FEATURES:remove = "obmc-fan-mgmt"
IMAGE_FEATURES:remove = "obmc-flash-mgmt"
IMAGE_FEATURES:remove = "obmc-fru-ipmi"
IMAGE_FEATURES:remove = "obmc-health-monitor"
IMAGE_FEATURES:remove = "obmc-host-ctl"
IMAGE_FEATURES:remove = "obmc-host-ipmi"
IMAGE_FEATURES:remove = "obmc-host-state-mgmt"
IMAGE_FEATURES:remove = "obmc-ikvm"
IMAGE_FEATURES:remove = "obmc-inventory"
IMAGE_FEATURES:remove = "obmc-leds"
IMAGE_FEATURES:remove = "obmc-logging-mgmt"
IMAGE_FEATURES:remove = "obmc-remote-logging-mgmt"
IMAGE_FEATURES:remove = "obmc-rng"
IMAGE_FEATURES:remove = "obmc-net-ipmi"
IMAGE_FEATURES:remove = "obmc-sensors"
IMAGE_FEATURES:remove = "obmc-software"
IMAGE_FEATURES:remove = "obmc-system-mgmt"
IMAGE_FEATURES:remove = "obmc-telemetry"
IMAGE_FEATURES:remove = "obmc-debug-collector"
IMAGE_FEATURES:remove = "obmc-settings-mgmt"
IMAGE_FEATURES:remove = "obmc-network-mgmt"
IMAGE_FEATURES:remove = "obmc-user-mgmt"
IMAGE_FEATURES:remove = "obmc-user-mgmt-ldap"
OBMC_IMAGE_BASE_INSTALL:remove = "packagegroup-obmc-apps-extras"

# Remove unneeded packages from image
IMAGE_INSTALL:remove = " \
    webui-vue \
    libmctp \
    entity-manager \
    dbus-sensors \
    "

IMAGE_INSTALL:remove = " \
    packagegroup-oss-apps \
    packagegroup-oss-libs \
    packagegroup-oss-intel-pmci \
    packagegroup-aspeed-obmc-apps \
    packagegroup-aspeed-apps \
    packagegroup-aspeed-crypto \
    packagegroup-aspeed-ssif \
    packagegroup-aspeed-obmc-inband \
    ${@bb.utils.contains('MACHINE_FEATURES', 'ast-ssp', 'packagegroup-aspeed-ssp', '', d)} \
    packagegroup-aspeed-mtdtest \
    packagegroup-aspeed-usbtools \
    ${@bb.utils.contains('DISTRO_FEATURES', 'tpm', \
        bb.utils.contains('MACHINE_FEATURES', 'tpm2', 'packagegroup-security-tpm2', '', d), \
        '', d)} \
    "

# Only install in AST26xx series rofs as the free space of AST2500 rofs is not enough.
IMAGE_INSTALL:remove = " \
    packagegroup-aspeed-ktools \
    "

EXTRA_IMAGE_FEATURES:remove = " \
    nfs-client \
    ${@bb.utils.contains('DISTRO_FEATURES', 'obmc-ubi-fs', 'read-only-rootfs-delayed-postinsts', '', d)} \
    ${@bb.utils.contains('DISTRO_FEATURES', 'phosphor-mmc', 'read-only-rootfs-delayed-postinsts', '', d)} \
    "
```

## meta-aspeed-sdk/meta-ast2600-sdk/conf/local.conf.sample
```bitbake
MACHINE ??= "ast2600-default"
#MACHINE ??= "ast2600-default-510"
#MACHINE ??= "ast2600-default-515"
#MACHINE ??= "ast2600-ecc"
#MACHINE ??= "ast2600-emmc"
#MACHINE ??= "ast2600-emmc-secure"
#MACHINE ??= "ast2600-ncsi"
#MACHINE ??= "ast2600-pfr"
#MACHINE ??= "ast2600-usbadp"
#MACHINE ??= "ast2600-secure-rsa2048-sha256"
#MACHINE ??= "ast2600-secure-rsa2048-sha256-ncot"
#MACHINE ??= "ast2600-secure-rsa2048-sha256-o1"
#MACHINE ??= "ast2600-secure-rsa2048-sha256-o2-pub"
#MACHINE ??= "ast2600-secure-rsa3072-sha384"
#MACHINE ??= "ast2600-secure-rsa3072-sha384-o1"
#MACHINE ??= "ast2600-secure-rsa3072-sha384-o2-pub"
#MACHINE ??= "ast2600-secure-rsa4096-sha512"
#MACHINE ??= "ast2600-secure-rsa4096-sha512-o1"
#MACHINE ??= "ast2600-secure-rsa4096-sha512-o2-pub"
#MACHINE ??= "ast2600-a2"
#MACHINE ??= "ast2600-a2-ecc"
#MACHINE ??= "ast2600-a2-emmc"
#MACHINE ??= "ast2600-a2-emmc-secure"
#MACHINE ??= "ast2600-a2-secure-rsa2048-sha256"
#MACHINE ??= "ast2600-a2-secure-rsa2048-sha256-ncot"
#MACHINE ??= "ast2600-a2-secure-rsa2048-sha256-o1"
#MACHINE ??= "ast2600-a2-secure-rsa2048-sha256-o2-pub"
#MACHINE ??= "ast2600-a2-secure-rsa3072-sha384"
#MACHINE ??= "ast2600-a2-secure-rsa3072-sha384-o1"
#MACHINE ??= "ast2600-a2-secure-rsa3072-sha384-o2-pub"
#MACHINE ??= "ast2600-a2-secure-rsa4096-sha512"
#MACHINE ??= "ast2600-a2-secure-rsa4096-sha512-o1"
#MACHINE ??= "ast2600-a2-secure-rsa4096-sha512-o2-pub"
#MACHINE ??= "ast2600-a1"
#MACHINE ??= "ast2600-a1-ecc"
#MACHINE ??= "ast2600-a1-secure-rsa2048-sha256"
#MACHINE ??= "ast2600-a1-secure-rsa2048-sha256-ncot"
#MACHINE ??= "ast2600-a1-secure-rsa2048-sha256-o1"
#MACHINE ??= "ast2600-a1-secure-rsa2048-sha256-o2-pub"
#MACHINE ??= "ast2600-a1-secure-rsa3072-sha384"
#MACHINE ??= "ast2600-a1-secure-rsa3072-sha384-o1"
#MACHINE ??= "ast2600-a1-secure-rsa3072-sha384-o2-pub"
#MACHINE ??= "ast2600-a1-secure-rsa4096-sha512"
#MACHINE ??= "ast2600-a1-secure-rsa4096-sha512-o1"
#MACHINE ??= "ast2600-a1-secure-rsa4096-sha512-o2-pub"
#MACHINE ??= "ast2605-default"

DISTRO ?= "openbmc-phosphor"
PACKAGE_CLASSES ?= "package_ipk"
SANITY_TESTED_DISTROS:append ?= " *"
EXTRA_IMAGE_FEATURES ?= "debug-tweaks"
USER_CLASSES ?= "buildstats"
PATCHRESOLVE = "noop"
BB_DISKMON_DIRS ??= "\
    STOPTASKS,${TMPDIR},1G,100K \
    STOPTASKS,${DL_DIR},1G,100K \
    STOPTASKS,${SSTATE_DIR},1G,100K \
    STOPTASKS,/tmp,100M,100K \
    ABORT,${TMPDIR},100M,1K \
    ABORT,${DL_DIR},100M,1K \
    ABORT,${SSTATE_DIR},100M,1K \
    ABORT,/tmp,10M,1K"
CONF_VERSION = "2"
INHERIT += "extrausers"
EXTRA_USERS_PARAMS = " \
  usermod -p '\$1\$UGMqyqdG\$FZiylVFmRRfl9Z0Ue8G7e/' root; \
  "

# Change time zone to local time from UTC for applying localtime
# in kernel build time.
TZ = '/etc/localtime'

require conf/machine/include/obmc-bsp-common.inc

# AST2600 Alternate Boot Record feature
#require conf/machine/include/ast-abr.inc

# Free Open Source Software (FOSS) Creation
# INHERIT += "archiver"
# ARCHIVER_MODE[src] = "original"
# ARCHIVER_MODE[recipe] = "1"
# COPYLEFT_LICENSE_INCLUDE = "*"
```

## meta-aspeed-sdk/meta-ast2600-sdk/conf/machine/ast2600-a1-515.conf
```bitbake
require conf/machine/ast2600-a1.conf

KERNEL_DEVICETREE = "aspeed-ast2600-evb-a1.dtb"

PREFERRED_VERSION_linux-aspeed = "5.15.%"
```

## meta-aspeed-sdk/meta-ast2600-sdk/conf/machine/ast2600-a1-54.conf
```bitbake
require conf/machine/ast2600-a1.conf

KERNEL_DEVICETREE = "aspeed-ast2600a1-evb.dtb"

PREFERRED_VERSION_linux-aspeed = "5.4.%"
```

## meta-aspeed-sdk/meta-ast2600-sdk/conf/machine/ast2600-a1-secure-rsa2048-sha256-ncot.conf
```bitbake
require conf/machine/ast2600-a1.conf
require conf/machine/include/ast2600-secure.inc

# Secure Boot Settings for OTP and RoT
ASPEED_SECURE_BOOT_CONFIG ?= "ast2600-a1_secure_RSA2048_SHA256.cfg"
```

## meta-aspeed-sdk/meta-ast2600-sdk/conf/machine/ast2600-a1-secure-rsa3072-sha384-o2-pub.conf
```bitbake
require conf/machine/ast2600-a1.conf
require conf/machine/include/ast2600-secure.inc
# Secure Boot Settings for CoT
require conf/machine/include/ast2600-secure-rsa3072-sha384-cot.inc

# Secure Boot Settings for OTP and RoT
ASPEED_SECURE_BOOT_CONFIG ?= "ast2600-a1_secure_RSA3072_SHA384_o2_pub.cfg"
```

## meta-aspeed-sdk/meta-ast2600-sdk/conf/machine/ast2600-a1-secure-rsa4096-sha512.conf
```bitbake
require conf/machine/ast2600-a1.conf
require conf/machine/include/ast2600-secure.inc

# Secure Boot Settings
ASPEED_SECURE_BOOT_CONFIG = "ast2600-a1_secure_RSA4096_SHA512.cfg"
```

## meta-aspeed-sdk/meta-ast2600-sdk/conf/machine/ast2600-a2-54.conf
```bitbake
require conf/machine/ast2600-a2.conf

KERNEL_DEVICETREE = "aspeed-ast2600a2-evb.dtb"

PREFERRED_VERSION_linux-aspeed = "5.4.%"
```

## meta-aspeed-sdk/meta-ast2600-sdk/conf/machine/ast2600-a2-emmc-secure-rsa4096-sha512-ncot.conf
```bitbake
require conf/machine/ast2600-emmc.conf
require conf/machine/include/ast2600-secure.inc

# Secure Boot Settings
ASPEED_SECURE_BOOT_CONFIG = "ast2600-a2-emmc_secure_RSA4096_SHA512_ncot.cfg"

# OpenBMC Settings
FLASH_UBOOT_IMAGE = "u-boot"
FLASH_KERNEL_IMAGE = "fitImage-${INITRAMFS_IMAGE}-${MACHINE}-${MACHINE}"
FLASH_KERNEL_IMAGE_df-obmc-ubi-fs = "fitImage-${MACHINE}.bin"
# OpenBMC EMMC settings
IMAGE_BOOT_FILES = "fitImage-${INITRAMFS_IMAGE}-${MACHINE}-${MACHINE};fitImage"

# ASPEED Initramfs Settings
ASPEED_IMAGE_UBOOT_IMAGE = "u-boot"
ASPEED_IMAGE_KERNEL_IMAGE = "fitImage-${INITRAMFS_IMAGE}-${MACHINE}-${MACHINE}"

# ASPEED EMMC Settings
ASPEED_EMMC_IMAGE_UBOOT_IMAGE = "u-boot"
```

## meta-aspeed-sdk/meta-ast2600-sdk/conf/machine/ast2600-a2-emmc-secure.conf
```bitbake
require conf/machine/ast2600-a2-emmc.conf
require conf/machine/include/ast2600-secure.inc
# Secure Boot Settings for CoT
require conf/machine/include/ast2600-secure-rsa4096-sha512-cot.inc

# Secure Boot Settings for OTP and RoT
ASPEED_SECURE_BOOT_CONFIG ?= "ast2600-a2-emmc_secure.cfg"
```

## meta-aspeed-sdk/meta-ast2600-sdk/conf/machine/ast2600-a2-secure-rsa2048-sha256-o2-pub.conf
```bitbake
require conf/machine/ast2600-a2.conf
require conf/machine/include/ast2600-secure.inc
# Secure Boot Settings for CoT
require conf/machine/include/ast2600-secure-rsa2048-sha256-cot.inc

# Secure Boot Settings for OTP and RoT
ASPEED_SECURE_BOOT_CONFIG ?= "ast2600-a2-secure_RSA2048_SHA256_o2_pub.cfg"
```

## meta-aspeed-sdk/meta-ast2600-sdk/conf/machine/ast2600-a2-secure-rsa3072-sha384-o1.conf
```bitbake
require conf/machine/ast2600-a2.conf
require conf/machine/include/ast2600-secure.inc
# Secure Boot Settings for CoT
require conf/machine/include/ast2600-secure-rsa3072-sha384-cot.inc

# Secure Boot Settings for OTP and RoT
ASPEED_SECURE_BOOT_CONFIG ?= "ast2600-a2-secure_RSA3072_SHA384_o1.cfg"
```

## meta-aspeed-sdk/meta-ast2600-sdk/conf/machine/ast2600-a2-secure-rsa3072-sha384-o2-pub.conf
```bitbake
require conf/machine/ast2600-a2.conf
require conf/machine/include/ast2600-secure.inc

# U-Boot Build Settings
UBOOT_MACHINE = "evb-ast2600-cot_defconfig"

# Secure Boot Settings
ASPEED_SECURE_BOOT_CONFIG = "ast2600-a2-secure_RSA3072_SHA384_o2_pub.cfg"
```

## meta-aspeed-sdk/meta-ast2600-sdk/conf/machine/ast2600-a2-secure-rsa4096-sha512-o1.conf
```bitbake
require conf/machine/ast2600-a2.conf
require conf/machine/include/ast2600-secure.inc

# Secure Boot Settings
ASPEED_SECURE_BOOT_CONFIG = "ast2600-a2-secure_RSA4096_SHA512_o1.cfg"
```

## meta-aspeed-sdk/meta-ast2600-sdk/conf/machine/ast2600-default-5.15.conf
```bitbake
require conf/machine/ast2600-default.conf

PREFERRED_VERSION_linux-aspeed = "5.15.%"

# Temporary remove at-scale-debug due to missing asm/rwonce.h header file
RDEPENDS:packagegroup-aspeed-obmc-apps:remove += "at-scale-debug"
```

## meta-aspeed-sdk/meta-ast2600-sdk/conf/machine/ast2600-default-54.conf
```bitbake
require conf/machine/ast2600-default.conf

PREFERRED_VERSION_linux-aspeed = "5.4.%"
```
